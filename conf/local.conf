## conf/local.conf
```bitbake
include "application.conf"

# Local developement database
db.default.user=ezb
db.default.password="password"
db.default.driver=org.postgresql.Driver
db.default.url="jdbc:postgresql://localhost/ezoombook"

cb.books.url="http://localhost/pools"
cb.books.bucket="ezoom-books"
cb.books.password=ezoomwiki
```
